## arch/arm/common/Kconfig
```kconfig
config ARM_GIC
	bool

config ARM_VIC
	bool

config ICST525
	bool

config ICST307
config ICST
	bool

config SA1111
	bool
	select DMABOUNCE

config DMABOUNCE
	bool

config TIMER_ACORN
	bool
	select DMABOUNCE if !ARCH_PXA

config DMABOUNCE
	bool
	select ZONE_DMA

config SHARP_LOCOMO
	bool

config SHARP_PARAM
	bool

config SHARPSL_PM
	bool
	select APM_EMULATION

config SHARP_SCOOP
	bool
```
