## arch/x86/xen/Kconfig
```kconfig
#
# This Kconfig describes xen options
#

config XEN
	bool "Xen guest support"
	select PARAVIRT
	select PARAVIRT_CLOCK
	depends on X86_64 || (X86_32 && X86_PAE && !(X86_VISWS || X86_VOYAGER))
	depends on X86_CMPXCHG && X86_TSC
	depends on PARAVIRT
	select PARAVIRT_CLOCK
	select XEN_HAVE_PVMMU
	select XEN_HAVE_VPMU
	depends on X86_64 || (X86_32 && X86_PAE)
	depends on X86_LOCAL_APIC && X86_TSC
	help
	  This is the Linux Xen port.  Enabling this will allow the
	  kernel to boot in a paravirtualized environment under the
	  Xen hypervisor.

config XEN_MAX_DOMAIN_MEMORY
       int "Maximum allowed size of a domain in gigabytes"
       default 8 if X86_32
       default 32 if X86_64
       depends on XEN
       help
         The pseudo-physical to machine address array is sized
         according to the maximum possible memory size of a Xen
         domain.  This array uses 1 page per gigabyte, so there's no
         need to be too stingy here.

config XEN_SAVE_RESTORE
       bool
       depends on PM
       default y
config XEN_DOM0
	def_bool y
	depends on XEN && PCI_XEN && SWIOTLB_XEN
	depends on X86_IO_APIC && ACPI && PCI

config XEN_PVHVM
	def_bool y
	depends on XEN && PCI && X86_LOCAL_APIC

config XEN_512GB
	bool "Limit Xen pv-domain memory to 512GB"
	depends on XEN && X86_64
	default y
	help
	  Limit paravirtualized user domains to 512GB of RAM.

	  The Xen tools and crash dump analysis tools might not support
	  pv-domains with more than 512 GB of RAM. This option controls the
	  default setting of the kernel to use only up to 512 GB or more.
	  It is always possible to change the default via specifying the
	  boot parameter "xen_512gb_limit".

config XEN_SAVE_RESTORE
       bool
       depends on XEN
       select HIBERNATE_CALLBACKS
       default y

config XEN_DEBUG_FS
	bool "Enable Xen debug and tuning parameters in debugfs"
	depends on XEN && DEBUG_FS
	default n
	help
	  Enable statistics output and various tuning options in debugfs.
	  Enabling this option may incur a significant performance overhead.

config XEN_PVH
	bool "Support for running as a PVH guest"
	depends on X86_64 && XEN && XEN_PVHVM
	def_bool n
```

## drivers/firewire/Kconfig
```kconfig
comment "A new alternative FireWire stack is available with EXPERIMENTAL=y"
	depends on EXPERIMENTAL=n

comment "Enable only one of the two stacks, unless you know what you are doing"
	depends on EXPERIMENTAL

config FIREWIRE
	tristate "New FireWire stack, EXPERIMENTAL"
	depends on EXPERIMENTAL
	select CRC_ITU_T
	help
	  This is the "Juju" FireWire stack, a new alternative implementation
	  designed for robustness and simplicity.  You can build either this
	  stack, or the old stack (the ieee1394 driver, ohci1394 etc.) or both.
	  Please read http://ieee1394.wiki.kernel.org/index.php/Juju_Migration
	  before you enable the new stack.
menu "IEEE 1394 (FireWire) support"
	depends on HAS_DMA
	depends on PCI || COMPILE_TEST
	# firewire-core does not depend on PCI but is
	# not useful without PCI controller driver

config FIREWIRE
	tristate "FireWire driver stack"
	select CRC_ITU_T
	help
	  This is the new-generation IEEE 1394 (FireWire) driver stack
	  a.k.a. Juju, a new implementation designed for robustness and
	  simplicity.
	  See http://ieee1394.wiki.kernel.org/index.php/Juju_Migration
	  for information about migration from the older Linux 1394 stack
	  to the new driver stack.

	  To compile this driver as a module, say M here: the module will be
	  called firewire-core.

	  This module functionally replaces ieee1394, raw1394, and video1394.
	  To access it from application programs, you generally need at least
	  libraw1394 version 2.  IIDC/DCAM applications also need libdc1394
	  version 2.  No libraries are required to access storage devices
	  through the firewire-sbp2 driver.

config FIREWIRE_OHCI
	tristate "OHCI-1394 controllers"
	depends on PCI && FIREWIRE
config FIREWIRE_OHCI
	tristate "OHCI-1394 controllers"
	depends on PCI && FIREWIRE && MMU
	help
	  Enable this driver if you have a FireWire controller based
	  on the OHCI specification.  For all practical purposes, this
	  is the only chipset in use, so say Y here.

	  To compile this driver as a module, say M here:  The module will be
	  called firewire-ohci.  It replaces ohci1394 of the classic IEEE 1394
	  stack.

	  NOTE:

	  You should only build either firewire-ohci or the old ohci1394 driver,
	  but not both.  If you nevertheless want to install both, you should
	  configure them only as modules and blacklist the driver(s) which you
	  don't want to have auto-loaded.  Add either

	      blacklist firewire-ohci
	  or
	      blacklist ohci1394
	      blacklist video1394
	      blacklist dv1394

	  to /etc/modprobe.conf or /etc/modprobe.d/* and update modprobe.conf
	  depending on your distribution.  The latter two modules should be
	  blacklisted together with ohci1394 because they depend on ohci1394.

	  If you have an old modprobe which doesn't implement the blacklist
	  directive, use "install modulename /bin/true" for the modules to be
	  blacklisted.

config FIREWIRE_OHCI_DEBUG
	bool
	depends on FIREWIRE_OHCI
	default y
	  called firewire-ohci.

config FIREWIRE_SBP2
	tristate "Storage devices (SBP-2 protocol)"
	depends on FIREWIRE && SCSI
	help
	  This option enables you to use SBP-2 devices connected to a
	  FireWire bus.  SBP-2 devices include storage devices like
	  harddisks and DVD drives, also some other FireWire devices
	  like scanners.

	  To compile this driver as a module, say M here:  The module will be
	  called firewire-sbp2.  It replaces sbp2 of the classic IEEE 1394
	  stack.

	  You should also enable support for disks, CD-ROMs, etc. in the SCSI
	  configuration section.
	  called firewire-sbp2.

	  You should also enable support for disks, CD-ROMs, etc. in the SCSI
	  configuration section.

config FIREWIRE_NET
	tristate "IP networking over 1394"
	depends on FIREWIRE && INET
	help
	  This enables IPv4/IPv6 over IEEE 1394, providing IP connectivity
	  with other implementations of RFC 2734/3146 as found on several
	  operating systems.  Multicast support is currently limited.

	  To compile this driver as a module, say M here:  The module will be
	  called firewire-net.

config FIREWIRE_NOSY
	tristate "Nosy - a FireWire traffic sniffer for PCILynx cards"
	depends on PCI
	help
	  Nosy is an IEEE 1394 packet sniffer that is used for protocol
	  analysis and in development of IEEE 1394 drivers, applications,
	  or firmwares.

	  This driver lets you use a Texas Instruments PCILynx 1394 to PCI
	  link layer controller TSB12LV21/A/B as a low-budget bus analyzer.
	  PCILynx is a nowadays very rare IEEE 1394 controller which is
	  not OHCI 1394 compliant.

	  The following cards are known to be based on PCILynx or PCILynx-2:
	  IOI IOI-1394TT (PCI card), Unibrain Fireboard 400 PCI Lynx-2
	  (PCI card), Newer Technology FireWire 2 Go (CardBus card),
	  Apple Power Mac G3 blue & white and G4 with PCI graphics
	  (onboard controller).

	  To compile this driver as a module, say M here:  The module will be
	  called nosy.  Source code of a userspace interface to nosy, called
	  nosy-dump, can be found in tools/firewire/ of the kernel sources.

	  If unsure, say N.

endmenu
```

## drivers/infiniband/hw/nes/Kconfig
```kconfig
config INFINIBAND_NES
	tristate "NetEffect RNIC Driver"
	depends on PCI && INET && INFINIBAND
	select LIBCRC32C
	select INET_LRO
	---help---
	  This is a low-level driver for NetEffect RDMA enabled
	  Network Interface Cards (RNIC).
	  This is the RDMA Network Interface Card (RNIC) driver for
	  NetEffect Ethernet Cluster Server Adapters.

config INFINIBAND_NES_DEBUG
	bool "Verbose debugging output"
	depends on INFINIBAND_NES
	default n
	---help---
	  This option causes the NetEffect RNIC driver to produce debug
	  messages.  Select this if you are developing the driver
	  or trying to diagnose a problem.
	  This option enables debug messages from the NetEffect RNIC
	  driver.  Select this if you are diagnosing a problem.
```

## drivers/net/wireless/p54/Kconfig
```kconfig
config P54_COMMON
	tristate "Softmac Prism54 support"
	depends on MAC80211 && WLAN_80211 && FW_LOADER && EXPERIMENTAL
	---help---
	  This is common code for isl38xx based cards.
	  This module does nothing by itself - the USB/PCI frontends
	  also need to be enabled in order to support any devices.

	  These devices require softmac firmware which can be found at
	  http://prism54.org/
	depends on MAC80211
	select FW_LOADER
	select CRC_CCITT
	---help---
	  This is common code for isl38xx/stlc45xx based modules.
	  This module does nothing by itself - the USB/PCI/SPI front-ends
	  also need to be enabled in order to support any devices.

	  These devices require softmac firmware which can be found at
	  <http://wireless.kernel.org/en/users/Drivers/p54>

	  If you choose to build a module, it'll be called p54common.

config P54_USB
	tristate "Prism54 USB support"
	depends on P54_COMMON && USB
	select CRC32
	---help---
	  This driver is for USB isl38xx based wireless cards.
	  These are USB based adapters found in devices such as:

	  3COM 3CRWE254G72
	  SMC 2862W-G
	  Accton 802.11g WN4501 USB
	  Siemens Gigaset USB
	  Netgear WG121
	  Netgear WG111
	  Medion 40900, Roper Europe
	  Shuttle PN15, Airvast WM168g, IOGear GWU513
	  Linksys WUSB54G
	  Linksys WUSB54G Portable
	  DLink DWL-G120 Spinnaker
	  DLink DWL-G122
	  Belkin F5D7050 ver 1000
	  Cohiba Proto board
	  SMC 2862W-G version 2
	  U.S. Robotics U5 802.11g Adapter
	  FUJITSU E-5400 USB D1700
	  Sagem XG703A
	  DLink DWL-G120 Cohiba
	  Spinnaker Proto board
	  Linksys WUSB54AG
	  Inventel UR054G
	  Spinnaker DUT

	  These devices require softmac firmware which can be found at
	  http://prism54.org/

	  These devices require softmac firmware which can be found at
	  <http://wireless.kernel.org/en/users/Drivers/p54>

	  If you choose to build a module, it'll be called p54usb.

config P54_PCI
	tristate "Prism54 PCI support"
	depends on P54_COMMON && PCI
	---help---
	  This driver is for PCI isl38xx based wireless cards.
	  This driver supports most devices that are supported by the
	  fullmac prism54 driver plus many devices which are not
	  supported by the fullmac driver/firmware.

	  This driver requires softmac firmware which can be found at
	  http://prism54.org/

	  If you choose to build a module, it'll be called p54pci.
	  <http://wireless.kernel.org/en/users/Drivers/p54>

	  If you choose to build a module, it'll be called p54pci.

config P54_SPI
	tristate "Prism54 SPI (stlc45xx) support"
	depends on P54_COMMON && SPI_MASTER
	---help---
	  This driver is for stlc4550 or stlc4560 based wireless chips
	  such as Nokia's N800/N810 Portable Internet Tablet.

	  If you choose to build a module, it'll be called p54spi.

config P54_SPI_DEFAULT_EEPROM
	bool "Include fallback EEPROM blob"
	depends on P54_SPI
	default n
	---help---
	 Unlike the PCI or USB devices, the SPI variants don't have
	 a dedicated EEPROM chip to store all device specific values
	 for calibration, country and interface settings.

	 The driver will try to load the image "3826.eeprom", if the
	 file is put at the right place. (usually /lib/firmware.)

	 Only if this request fails, this option will provide a
	 backup set of generic values to get the device working.

	 Enabling this option adds about 4k to p54spi.

config P54_LEDS
	bool
	depends on P54_COMMON && MAC80211_LEDS && (LEDS_CLASS = y || LEDS_CLASS = P54_COMMON)
	default y
```
